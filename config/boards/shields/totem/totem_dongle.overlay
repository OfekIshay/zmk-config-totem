/*
 * Copyright (c) 2022 The ZMK Contributors
 *
 * SPDX-License-Identifier: MIT
 */

  / {
        chosen {
          zephyr,display = &oled;
        };
 xiao_i2c {
    status = "okay";
    #address-cells = <1>;
    #size-cells = <0>;
    oled: ssd1306@3c {
        compatible = "solomon,ssd1306fb-i2c";
        reg = <0x3C>;  // I2C address of the OLED
        width = <128>;
        height = <64>;
        segment-offset = <0>;
        page-offset = <0>;
        display-offset = <0>;
        multiplex-ratio = <63>;
        segment-remap;
        com-invdir;
        inversion-on;
        prechargep = <0x22>;
        reset-gpios = <&gpio0 6 GPIO_ACTIVE_LOW>; // Change based on your wiring
    };
 };
};
