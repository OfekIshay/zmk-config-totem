## config/west.yml
```yaml
manifest:
  remotes:
    - name: zmkfirmware
      url-base: https://github.com/zmkfirmware
    - name: caksoylar
      url-base: https://github.com/caksoylar
    - name: mine
      url-base: https://github.com/OfekIshay
  projects:
    - name: zmk
      remote: mine
      revision: feat/mouse-keys-3.2
      import: app/west.yml
  self:
    path: config
```
